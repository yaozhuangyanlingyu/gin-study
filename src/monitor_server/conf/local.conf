## src/monitor_server/conf/local.conf
```bitbake
[Server]
Host = 127.0.0.1
Port = 8110

[RedisDev]
Host = 127.0.0.1
Port = 6379
Database = 10

[RedisProd]

[Log]
LogDir = "logs"
LogFile = "monitor"

[WxPushMsg]
GetTokenUrl = "https://qyapi.weixin.qq.com/cgi-bin/gettoken?corpid=%s&corpsecret=%s"
PushUrl = "https://qyapi.weixin.qq.com/cgi-bin/message/send?access_token=%s"
Corpid = "wwde96ee9bc90ebb43"
Corpsecret = "h3MleGzWRq7j6SUkHWMm1WJrE7cR5yscGxLQunSLKfk"
AgentId = 1000002
```
